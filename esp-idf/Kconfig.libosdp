## esp-idf/Kconfig.libosdp
```kconfig
#
#  Copyright (c) 2026 Siddharth Chandrasekaran <sidcha.dev@gmail.com>
#
#  SPDX-License-Identifier: Apache-2.0
#
# ESP-IDF Kconfig for LibOSDP. Ported from zephyr/Kconfig; symbol names are kept
# identical so configuration knowledge carries between the two integrations.
# Zephyr-only plumbing (select CRC/CRYPTO/MBEDTLS_*, imply UART_*) is dropped --
# ESP-IDF always builds its mbedtls and UART drivers.
#
# Sourced from the repo-root Kconfig, which is where ESP-IDF looks for it.

menuconfig LIBOSDP
	bool "Open Supervised Device Protocol (OSDP)"
	default y
	help
	  Build LibOSDP, an implementation of the Open Supervised Device
	  Protocol (IEC 60839-11-5). Provides both CP (control panel) and
	  PD (peripheral device) roles.

if LIBOSDP

choice LIBOSDP_CRYPTO_BACKEND
	prompt "LibOSDP crypto backend"
	default LIBOSDP_CRYPTO_MBEDTLS
	help
	  Select which AES implementation LibOSDP uses for secure channel
	  crypto. Prefer MbedTLS on ESP-IDF: it is part of the SDK, so it is
	  almost certainly linked already, and on targets with a crypto
	  accelerator ESP-IDF's port routes AES through the hardware.

config LIBOSDP_CRYPTO_MBEDTLS
	bool "MbedTLS"
	help
	  Use ESP-IDF's bundled MbedTLS for AES. Shares code with the rest
	  of the system if MbedTLS is already linked.

config LIBOSDP_CRYPTO_TINYAES
	bool "TinyAES (in-tree)"
	help
	  Use the bundled TinyAES implementation. No external crypto
	  dependency; smallest code size, software-only.

endchoice

config LIBOSDP_STATIC
	bool "Static allocation (no malloc/free)"
	default y
	help
	  Allocate all LibOSDP internal structures statically. PD arrays are
	  sized to OSDP_PD_MAX. This eliminates all dynamic memory allocation
	  inside LibOSDP.

config LIBOSDP_RX_ZERO_COPY
	bool "Enable zero-copy RX buffers"
	default n
	help
	  Take RX buffers directly from the driver instead of ring-buffering
	  byte by byte inside LibOSDP.

	  This changes the shape of struct osdp_channel: the application must
	  supply recv_pkt() and release_pkt() instead of recv(), and recv_pkt()
	  must hand over whole packets. ESP-IDF's UART driver already
	  ring-buffers internally and uart_read_bytes() copies out of it, so
	  the default (n) is both simpler and no more expensive; enable this
	  only with a transport that can expose packet-aligned buffers.

config LIBOSDP_SKIP_MARK_BYTE
	bool "Don't send the leading mark byte (0xFF)"
	default n

config LIBOSDP_LOG_MINIMAL
	bool "Minimal logging (reduced RAM/stack)"
	default n
	help
	  Drop the full logger (utils/src/logger.c) and route messages through
	  the callback registered with osdp_set_log_callback(). Saves RAM and
	  stack space; osdp_logger_init() is not available in this mode.

config LIBOSDP_DISABLE_PRETTY_LOGGING
	bool "Don't colorize log outputs"
	default n

config LIBOSDP_PACKET_TRACE
	bool "Enable OSDP packet trace (PCAP)"
	default n
	help
	  Record raw OSDP packets for diagnostics. Enables PCAP capture
	  support via osdp_diag.

config LIBOSDP_DATA_TRACE
	bool "Enable OSDP data buffer trace"
	default n
	help
	  Trace command/reply data buffers for diagnostics. Enables PCAP
	  capture support via osdp_diag.

menu "OSDP Protocol Timings"

config OSDP_PD_SC_RETRY_MS
	int "PD secure channel retry timeout (ms)"
	default 600000
	help
	  Time in milliseconds after which PD retries to establish secure
	  channel with CP. Default: 600000 (10 minutes)

config OSDP_PD_POLL_TIMEOUT_MS
	int "PD poll timeout (ms)"
	default 50
	help
	  Maximum time in milliseconds PD waits for a poll command from CP
	  before going offline. Default: 50ms

config OSDP_PD_SC_TIMEOUT_MS
	int "PD secure channel timeout (ms)"
	default 8000
	help
	  Time in milliseconds after which PD considers secure channel to be
	  inactive. Default: 8000 (8 seconds)

config OSDP_PD_ONLINE_TOUT_MS
	int "PD online timeout (ms)"
	default 8000
	help
	  Time in milliseconds after which CP considers PD to be offline if
	  no response received. Default: 8000 (8 seconds)

config OSDP_RESP_TOUT_MS
	int "Response timeout (ms)"
	default 200
	help
	  Maximum time in milliseconds to wait for a response after sending
	  a command. Default: 200ms

config OSDP_CMD_RETRY_WAIT_MS
	int "Command retry wait time (ms)"
	default 800
	help
	  Time in milliseconds to wait before retrying a failed command.
	  Default: 800ms

config OSDP_ONLINE_RETRY_WAIT_INIT_MS
	int "Initial online retry wait (ms)"
	default 1000
	help
	  Time in milliseconds to wait before the first attempt to bring a PD
	  back online after it was declared offline. Every further failure
	  doubles the wait, up to the maximum below, and a PD that comes online
	  starts over. Default: 1000 (1 second)

config OSDP_ONLINE_RETRY_WAIT_MAX_MS
	int "Maximum online retry wait (ms)"
	default 300000
	help
	  Maximum time in milliseconds to wait before retrying to bring a PD
	  online. Default: 300000 (5 minutes)

endmenu # OSDP Protocol Timings

menu "OSDP Protocol Limits"

config OSDP_CMD_MAX_RETRIES
	int "Maximum command retries"
	default 8
	help
	  Maximum number of times to retry a failed command before giving up.
	  Default: 8

config OSDP_FILE_ERROR_RETRY_MAX
	int "Maximum file transfer error retries"
	default 10
	help
	  Maximum number of times to retry a failed file transfer operation.
	  Default: 10

config OSDP_PD_MAX
	int "Maximum number of PDs"
	default 126
	range 1 126
	help
	  Maximum number of PDs a CP can manage, and the size of the
	  statically allocated PD array under LIBOSDP_STATIC. A PD-only
	  application should set this to 1: at 126 the static arenas cost
	  several KB of RAM for PDs that will never exist.

config OSDP_PD_NAME_MAXLEN
	int "Maximum PD name length"
	default 16
	help
	  Maximum length of PD name string. Default: 16

endmenu # OSDP Protocol Limits

menu "OSDP Memory Configuration"

config OSDP_PACKET_BUF_SIZE
	int "OSDP packet buffer size"
	default 1024
	help
	  Maximum OSDP packet size. Must be at least 256 bytes. 1024 is the
	  largest packet OSDP defines.

config OSDP_MINIMUM_PACKET_SIZE
	int "Minimum OSDP packet size"
	default 128
	help
	  Minimum expected OSDP packet size for validation. Default: 128 bytes

config OSDP_RX_RB_SIZE
	int "RX ring buffer size"
	default 512
	help
	  Size of receive ring buffer for byte-by-byte reception mode. Only
	  used when LIBOSDP_RX_ZERO_COPY is disabled. Default: 512 bytes

config OSDP_CP_CMD_POOL_SIZE
	int "CP command pool size"
	default 4
	help
	  Number of command slots in the CP command pool. Larger values allow
	  queuing more commands. Unused by a PD-only application.

endmenu # OSDP Memory Configuration

menu "OSDP Internal Constants"

config OSDP_CMD_ID_OFFSET
	int "Command ID offset"
	default 5
	help
	  Offset of command ID field in OSDP packet. Default: 5

config OSDP_PCAP_LINK_TYPE
	int "PCAP link type for packet capture"
	default 162
	help
	  Link type identifier for OSDP PCAP files. Default: 162

endmenu # OSDP Internal Constants

endif # LIBOSDP
```
